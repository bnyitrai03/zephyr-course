## boards/from_scratch/Kconfig.from_scratch
```kconfig
config BOARD_FROM_SCRATCH
	select SOC_MCXN236
	select SOC_PART_NUMBER_MCXN236VDF
```

## boards/from_scratch/board.yml
```yaml
board:
  name: from_scratch
  full_name: From Scratch Board
  vendor: iomico
  socs:
  - name: mcxn236
```

## boards/from_scratch/from_scratch_defconfig
```kconfig
CONFIG_GPIO=y
CONFIG_CONSOLE=y
CONFIG_UART_CONSOLE=y
CONFIG_SERIAL=y
CONFIG_UART_INTERRUPT_DRIVEN=y

CONFIG_TRUSTED_EXECUTION_SECURE=y.
```
